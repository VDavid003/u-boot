## board/samsung/exynos7885_common/Kconfig
```kconfig
if TARGET_JACKPOTLTE

config EXYNOS7885
	bool "Exynos7885 SoC support"
	default y

config SYS_BOARD
	default "exynos7885_common"

config SYS_VENDOR
	default "samsung"

config SYS_CONFIG_NAME
	default "jackpotlte"

endif

if TARGET_XCOVER4S

config EXYNOS7885
	bool "Exynos7885 SoC support"
	default y

config SYS_BOARD
	default "exynos7885_common"

config SYS_VENDOR
	default "samsung"

config SYS_CONFIG_NAME
	default "xcover4s"

endif
```

## board/samsung/jackpotlte/Kconfig
```kconfig
if TARGET_JACKPOTLTE

config EXYNOS7885
	bool "Exynos7885 SoC support"
	default y

config SYS_BOARD
	default "jackpotlte"

config SYS_VENDOR
	default "samsung"

config SYS_CONFIG_NAME
	default "jackpotlte"

endif
```

## configs/jackpotlte_defconfig
```kconfig
CONFIG_ARM=y
CONFIG_POSITION_INDEPENDENT=y
CONFIG_ARCH_CPU_INIT=y
CONFIG_ARCH_EXYNOS=y
CONFIG_SYS_MALLOC_LEN=0x81f000
CONFIG_SYS_MALLOC_F_LEN=0x4000
CONFIG_ARCH_EXYNOS9=y
CONFIG_DEFAULT_DEVICE_TREE="exynos/exynos7885-jackpotlte"
CONFIG_SYS_LOAD_ADDR=0x80000000
# CONFIG_AUTOBOOT is not set
CONFIG_USE_PREBOOT=y
CONFIG_PREBOOT="i2c dev 1; i2c mw 0x3D 0xCA 0x48 1; i2c mw 0x3D 0xC7 0x12 1;"
# CONFIG_DISPLAY_CPUINFO is not set
CONFIG_CMD_CLK=y
CONFIG_CMD_GPIO=y
CONFIG_CMD_I2C=y
# CONFIG_NET is not set
CONFIG_BUTTON=y
CONFIG_CLK_EXYNOS7885=y
CONFIG_SYS_I2C_S3C24X0=y
CONFIG_BUTTON_KEYBOARD=y
# CONFIG_MMC is not set
CONFIG_SOC_SAMSUNG=y
CONFIG_SYSRESET=y
CONFIG_SYSRESET_SYSCON=y
```

## configs/xcover4s_defconfig
```kconfig
CONFIG_ARM=y
CONFIG_POSITION_INDEPENDENT=y
CONFIG_ARCH_CPU_INIT=y
CONFIG_ARCH_EXYNOS=y
CONFIG_SYS_MALLOC_LEN=0x81f000
CONFIG_SYS_MALLOC_F_LEN=0x4000
CONFIG_ARCH_EXYNOS9=y
CONFIG_TARGET_XCOVER4S=y
CONFIG_DEFAULT_DEVICE_TREE="exynos/exynos7885-xcover4s"
CONFIG_SYS_LOAD_ADDR=0x80000000
CONFIG_FIT=y
CONFIG_BOOTDELAY=30
CONFIG_AUTOBOOT_MENU_SHOW=y
# CONFIG_DISPLAY_CPUINFO is not set
CONFIG_CMD_BOOTMENU=y
CONFIG_CMD_CLK=y
CONFIG_CMD_GPIO=y
CONFIG_CMD_I2C=y
# CONFIG_NET is not set
CONFIG_BUTTON=y
CONFIG_CLK_EXYNOS7885=y
CONFIG_SYS_I2C_S3C24X0=y
CONFIG_BUTTON_KEYBOARD=y
# CONFIG_MMC is not set
CONFIG_SOC_SAMSUNG=y
CONFIG_SYSRESET=y
CONFIG_SYSRESET_SYSCON=y
CONFIG_VIDEO=y
# CONFIG_VIDEO_FONT_8X16 is not set
CONFIG_VIDEO_FONT_16X32=y
# CONFIG_BACKLIGHT is not set
# CONFIG_PANEL is not set
CONFIG_VIDEO_SIMPLE=y
CONFIG_VIDEO_DT_SIMPLEFB=y
```
