// SPDX-License-Identifier: GPL-2.0+
/*
 * Samsung's Exynos7885 SoC pin-mux and pin-config device tree source
 *
 * Copyright (c) 2023 Dávid Virág (virag.david003@gmail.com)
 *
 * Samsung's Exynos7885 SoC pin-mux and pin-config options are listed as device
 * tree nodes are listed in this file.
 *
 * This program is free software; you can redistribute it and/or modify
 * it under the terms of the GNU General Public License version 2 as
 * published by the Free Software Foundation.
 */

/ {

};

/* ALIVE */
&pinctrl_alive {
	uart2_bus: uart2-bus {
		samsung,pins = "gpq0-4", "gpq0-3";
		samsung,pin-function = <2>;
		samsung,pin-pud = <0>;
	};

};

/* TOP */
&pinctrl_top {
	i2c1_bus: i2c1-bus {
		samsung,pins = "gpp1-3", "gpp1-2";
		samsung,pin-function = <2>;
		samsung,pin-con-pdn = <3>;
		samsung,pin-pud = <3>;
		samsung,pin-drv = <0>;
	};
};
